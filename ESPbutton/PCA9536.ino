//////////////////////////////////////////////////////////////////////////////////////////
//////////////////////////////////////////////////////////////////////////////////////////
//////////////////////////////////////////////////////////////////////////////////////////

void init_io()
{
    Wire.begin(0, 2); // connect SDA to GPIO0 and SCL to GPIO2
    check_PCA();      // check if PCA9536 is present
    setup_PCA();      // set up PCA input port

    if (PCA)
    {
        if (battery_powered)
            SENT = false;
        else
            init_buttons(); // get current button state
    }
}

//////////////////////////////////////////////////////////////////////////////////////////
//////////////////////////////////////////////////////////////////////////////////////////
//////////////////////////////////////////////////////////////////////////////////////////

void check_PCA()
{
    Wire.beginTransmission(PCA_ADR);
    if (Wire.endTransmission() == 0)
        PCA = true;
}

//////////////////////////////////////////////////////////////////////////////////////////
//////////////////////////////////////////////////////////////////////////////////////////
//////////////////////////////////////////////////////////////////////////////////////////

void setup_PCA()
{
    uint8_t polarity = 0x00;

    switch (button_type)
    {
    case 0:
        polarity = 0xFF;
        break;
    case 1:
        polarity = 0xF0;
        break;
    case 2:
        polarity = 0xFF;
        break;
    }

    Wire.beginTransmission(PCA_ADR);
    Wire.write(POL_REG);
    Wire.write(polarity);
    Wire.endTransmission();
}

//////////////////////////////////////////////////////////////////////////////////////////
//////////////////////////////////////////////////////////////////////////////////////////
//////////////////////////////////////////////////////////////////////////////////////////

void init_buttons()
{
    Wire.beginTransmission(PCA_ADR);
    Wire.write(INP_REG);
    if (Wire.endTransmission() == 0)
    {
        Wire.requestFrom(PCA_ADR, BYTE);
        if (Wire.available())
            butoane_last = Wire.read() & 0x0F;

        butoane = butoane_last;
        xb = butoane_last;
    }
}

//////////////////////////////////////////////////////////////////////////////////////////
//////////////////////////////////////////////////////////////////////////////////////////
//////////////////////////////////////////////////////////////////////////////////////////

void check_buttons()
{
    Wire.beginTransmission(PCA_ADR);
    Wire.write(INP_REG);
    if (Wire.endTransmission() == 0)
    {
        Wire.requestFrom(PCA_ADR, BYTE);
        if (Wire.available())
            butoane = Wire.read() & 0x0F;
    }
    else
    {
        while (Wire.available())
            Wire.read();
    }

    if (butoane == butoane_last)
        return;

    ab = butoane & butoane_last;
    if (button_type == 2)
        ab = butoane_last;
    xb = butoane ^ ab;

    butoane_last = butoane;

    if (xb > 0)
        SENT = false;
}

//////////////////////////////////////////////////////////////////////////////////////////
//////////////////////////////////////////////////////////////////////////////////////////
//////////////////////////////////////////////////////////////////////////////////////////
